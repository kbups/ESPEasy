#ifdef USES_P230
//#######################################################################################################
//####################################  230: Display - ILI9341 ##########################################
//#######################################################################################################

#include <Adafruit_ILI9341.h>
#include "fonts/RobotoLight6pt7b.h"
#include "fonts/RobotoLight7pt7b.h"
#include "fonts/RobotoLight10pt7b.h"
#include "fonts/RobotoLight12pt7b.h"
#include "fonts/RobotoLight16pt7b.h"
#include "fonts/RobotoLight17pt7b.h"

#define PLUGIN_230
#define PLUGIN_ID_230         230
#define PLUGIN_NAME_230       "Display - ILI9341"
#define PLUGIN_VALUENAME1_230 "TFT"

// SCREEN
#define TFT_DC 15 // 5 = GPIO5 = D1, 15 = GPIO15 = D8
#define TFT_CS 16 // 4 = GPIO4 = D2, 16 = GPIO16 = D0
#define TFT_ROTATE 2 // 1 Horizontal (pins on right) / 3 Horizontal (pins on left)

#define SCREEN_BGCOLOR 0x18E3 			/* HEX: #1e1e1e / RGB565: 0x18E3 */
#define SCREEN_FGCOLOR 0xFFFF			/* HEX: #FFFFFF / RGB565: 0xFFFF */
#define SCREEN_TITLECOLOR 0x4459 		/* HEX: #428bca / RGB565: 0x4459 */

#define SCREEN_WIFIACTIVATED 0xFFFF 	/* HEX: #FFFFFF / RGB565: 0xFFFF */
#define SCREEN_WIFIDEACTIVATED 0xF800 	/* HEX: #FF0000 / RGB565: 0xF800 */

#define SCREEN_PANEL1_BGCOLOR 0x64CC	/* HEX: #629862 / RGB565: 0x64CC */
#define SCREEN_PANEL2_BGCOLOR 0x836E	/* HEX: #846d74 / RGB565: 0x836E */
#define SCREEN_PANEL3_BGCOLOR 0x4459	/* HEX: #428bca / RGB565: 0x4459 */
#define SCREEN_PANEL4_BGCOLOR 0xE461	/* HEX: #e28f09 / RGB565: 0xE461 */
#define SCREEN_PANEL5_BGCOLOR 0xAD40	/* HEX: #abaa01 / RGB565: 0xAD40 */


static unsigned char temperature_bits[] = {
   0x00, 0x80, 0x07, 0x00, 0x00, 0x00, 0xc0, 0x0f, 0x00, 0x00, 0x00, 0x60,
   0x18, 0x00, 0x00, 0x00, 0x60, 0x10, 0x00, 0x00, 0x00, 0x60, 0x30, 0x00,
   0x00, 0x00, 0x60, 0x30, 0x7e, 0x00, 0x00, 0x60, 0x30, 0x7e, 0x00, 0x00,
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   0x3f, 0x00, 0x00, 0x00, 0xc0, 0x0f, 0x00, 0x00 };

static unsigned char drop_bits[] = {
   0x00, 0x00, 0x18, 0x00, 0x00, 0x00, 0x00, 0x3c, 0x00, 0x00, 0x00, 0x00,
   0x3c, 0x00, 0x00, 0x00, 0x00, 0x66, 0x00, 0x00, 0x00, 0x00, 0xc3, 0x00,
   0x00, 0x00, 0x80, 0x81, 0x01, 0x00, 0x00, 0xc0, 0x81, 0x03, 0x00, 0x00,
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   0xff, 0x03, 0x00, 0x00, 0x00, 0xff, 0x00, 0x00 };

static unsigned char sun_bits[] = {
   0x00, 0x00, 0x18, 0x00, 0x00, 0x00, 0x00, 0x18, 0x00, 0x00, 0x00, 0x00,
   0x18, 0x00, 0x00, 0x00, 0x0c, 0x18, 0x30, 0x00, 0x00, 0x0c, 0x18, 0x30,
   0x00, 0x00, 0x1c, 0x00, 0x38, 0x00, 0x00, 0x18, 0x00, 0x18, 0x00, 0x00,
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   0x18, 0x00, 0x00, 0x00, 0x00, 0x18, 0x00, 0x00 };

static unsigned char water_bits[] = {
   0x00, 0x00, 0x00, 0x00, 0x00, 0x00, 0x00, 0x00, 0x00, 0x00, 0x00, 0x00,
   0x00, 0x00, 0x00, 0x00, 0x00, 0x00, 0x00, 0x00, 0x00, 0x00, 0x00, 0x00,
   0x00, 0x00, 0x00, 0x00, 0x00, 0x00, 0x00, 0x00, 0x00, 0x00, 0x00, 0x00,
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   0x00, 0x00, 0x00, 0x00, 0x00, 0x00, 0x00, 0x00 };

static unsigned char days_bits[] = {
   0x00, 0x0e, 0x00, 0x70, 0x00, 0x00, 0x1f, 0x00, 0xf8, 0x00, 0x80, 0x1f,
   0x00, 0xf8, 0x01, 0x80, 0x1f, 0x00, 0xf8, 0x01, 0x80, 0x1f, 0x00, 0xf8,
   0x01, 0xbf, 0xdf, 0xff, 0xfb, 0xfd, 0x3f, 0xdf, 0xff, 0xfb, 0xfc, 0x3f,
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   0xff, 0xff, 0xff, 0xff, 0xff, 0xff, 0xff, 0xff };

static unsigned char switch_bg_off_bits[] = {
   0xff, 0xff, 0x00, 0xfc, 0xff, 0x03, 0xf8, 0xff, 0x07, 0xf0, 0xff, 0x0f,
   0x00, 0xc0, 0x1f, 0x00, 0x00, 0x1f, 0x00, 0x00, 0x3e, 0x00, 0x00, 0x3e,
   0x00, 0x00, 0x3c, 0x00, 0x00, 0x3c, 0x00, 0x00, 0x3c, 0x00, 0x00, 0x3c,
   0x00, 0x00, 0x3e, 0x00, 0x00, 0x3e, 0x00, 0x00, 0x1f, 0x00, 0x80, 0x1f,
   0xf0, 0xff, 0x0f, 0xf8, 0xff, 0x0f, 0xfc, 0xff, 0x03, 0xff, 0xff, 0x01 };

static unsigned char switch_bg_on_bits[] = {
   0xe0, 0xff, 0x3f, 0xf0, 0xff, 0x0f, 0xfc, 0xff, 0x07, 0xfc, 0xff, 0x03,
   0x7e, 0x00, 0x00, 0x3e, 0x00, 0x00, 0x1f, 0x00, 0x00, 0x1f, 0x00, 0x00,
   0x0f, 0x00, 0x00, 0x0f, 0x00, 0x00, 0x0f, 0x00, 0x00, 0x0f, 0x00, 0x00,
   0x1f, 0x00, 0x00, 0x1f, 0x00, 0x00, 0x3e, 0x00, 0x00, 0xfe, 0x00, 0x00,
   0xfc, 0xff, 0x03, 0xf8, 0xff, 0x07, 0xf0, 0xff, 0x3f, 0xc0, 0xff, 0x3f };

static unsigned char switch_btn_bits[] = {
   0x00, 0x0f, 0x00, 0xe0, 0x7f, 0x00, 0xf0, 0xff, 0x00, 0xf8, 0xff, 0x01,
   0xfc, 0xff, 0x03, 0xfe, 0xf0, 0x07, 0x3e, 0xc0, 0x07, 0x3e, 0xc0, 0x07,
   0x1f, 0x80, 0x0f, 0x1f, 0x80, 0x0f, 0x1f, 0x80, 0x0f, 0x1f, 0x80, 0x0f,
   0x3e, 0xc0, 0x07, 0x3e, 0xc0, 0x07, 0xfe, 0xf0, 0x07, 0xfc, 0xff, 0x03,
   0xf8, 0xff, 0x01, 0xf0, 0xff, 0x00, 0xe0, 0x7f, 0x00, 0x00, 0x0f, 0x00 };

Adafruit_ILI9341* tft;
String prev_systime = "";
String prev_sysdate = "";
String prev_sysip   = "";
String prev_row1 = "";
String prev_row2 = "";

boolean Plugin_230(byte function, struct EventStruct *event, String& string)
{
  boolean success = false;

  // static byte portValue = 0;

  switch (function)
  {
    case PLUGIN_DEVICE_ADD:
      {
        Device[++deviceCount].Number = PLUGIN_ID_230;
        Device[deviceCount].Type = DEVICE_TYPE_I2C;
        Device[deviceCount].VType = SENSOR_TYPE_NONE;
        Device[deviceCount].Ports = 0;
        Device[deviceCount].PullUpOption = false;
        Device[deviceCount].InverseLogicOption = false;
        Device[deviceCount].FormulaOption = false;
        Device[deviceCount].ValueCount = 0;
        Device[deviceCount].SendDataOption = false;
        Device[deviceCount].TimerOption = true;
        Device[deviceCount].GlobalSyncOption = true;
        break;
      }

    case PLUGIN_GET_DEVICENAME:
      {
        string = F(PLUGIN_NAME_230);
        break;
      }

    case PLUGIN_GET_DEVICEVALUENAMES:
      {
        strcpy_P(ExtraTaskSettings.TaskDeviceValueNames[0], PSTR(PLUGIN_VALUENAME1_230));
        break;
      }

    case PLUGIN_WEBFORM_LOAD:
      {
        byte choice = Settings.TaskDevicePluginConfig[event->TaskIndex][0];
        /*String options[2] = { F("3C"), F("3D") };*/
        int optionValues[2] = { 0x3C, 0x3D };
        addFormSelectorI2C(F("plugin_230_adr"), 2, optionValues, choice);

        addFormPinSelect(F("TFT_CS"), F("taskdevicepin3"), Settings.TaskDevicePin3[event->TaskIndex]);

        byte choice2 = Settings.TaskDevicePluginConfig[event->TaskIndex][1];
        String options2[4] = { F("0°"), F("90°"), F("180°"), F("270°") };
        int optionValues2[4] = { 1, 2, 3, 4 };
        addFormSelector(F("Rotation"), F("plugin_230_rotate"), 4, options2, optionValues2, choice2);

        char deviceTemplate[4][64];
        LoadCustomTaskSettings(event->TaskIndex, (byte*)&deviceTemplate, sizeof(deviceTemplate));
        for (byte varNr = 0; varNr < 4; varNr++)
        {
          addFormTextBox(String(F("Tile ")) + (varNr + 1), String(F("Plugin_230_template")) + (varNr + 1), deviceTemplate[varNr], 64);
        }

        success = true;
        break;
      }

    case PLUGIN_WEBFORM_SAVE:
      {
        Settings.TaskDevicePluginConfig[event->TaskIndex][0] = getFormItemInt(F("plugin_230_adr"));
        Settings.TaskDevicePluginConfig[event->TaskIndex][1] = getFormItemInt(F("plugin_230_rotate"));

        char deviceTemplate[4][64];
        for (byte varNr = 0; varNr < 4; varNr++)
        {
          String arg = F("Plugin_230_template");
          arg += varNr + 1;
          String tmpString = WebServer.arg(arg);
          strncpy(deviceTemplate[varNr], tmpString.c_str(), sizeof(deviceTemplate[varNr])-1);
          deviceTemplate[varNr][63]=0;
        }

        SaveCustomTaskSettings(event->TaskIndex, (byte*)&deviceTemplate, sizeof(deviceTemplate));

        success = true;
        break;
      }

    case PLUGIN_INIT:
      {
        int index = Settings.TaskDevicePluginConfig[event->TaskIndex][0] == 0x3C
         ? 0
         : 1;
        P230_initialize();
        //tft = new Adafruit_ILI9341(TFT_CS, TFT_DC);
        //tft->begin();
        //tft->setRotation(2);// TODO

        // General
        //tft->fillScreen(SCREEN_BGCOLOR);
        //OLED_Settings[index].address = Settings.TaskDevicePluginConfig[event->TaskIndex][0];

        success = true;
        break;
      }

    case PLUGIN_TEN_PER_SECOND:
      {

        break;
      }

    case PLUGIN_ONCE_A_SECOND:
      {
        int index = Settings.TaskDevicePluginConfig[event->TaskIndex][0] == 0x3C
          ? 0
          : 1;
        break;
      }

    case PLUGIN_READ:
      {
        String log = F("ILI9341  : TEST: TODO");
        addLog(LOG_LEVEL_INFO,log);

        char deviceTemplate[4][64];
        LoadCustomTaskSettings(event->TaskIndex, (byte*)&deviceTemplate, sizeof(deviceTemplate));
        int index = Settings.TaskDevicePluginConfig[event->TaskIndex][0] == 0x3C
          ? 0
          : 1;

        // Display time
        String systime = getTimeString(':');
        P230_update_time(prev_systime, systime);
        prev_systime = systime;

        // Display date
        char strDate[12];
        sprintf_P(strDate, PSTR("%d %s %04d"), day(), P230_get_month(month()).c_str(), year());
        String sysdate = String(strDate);
        P230_update_date(prev_sysdate, sysdate);
        prev_sysdate = sysdate;

        // Display WIFI
        String sysip = WiFi.localIP().toString() + " / " + WiFi.softAPIP().toString();
        P230_display_wifi_status(WiFi.status() == WL_CONNECTED, sysip, prev_sysip);
        prev_sysip = sysip;

        for (byte x = 0; x < 4; x++)
        {
          String tmpString = deviceTemplate[x];
          if (tmpString.length())
          {
            // #define F(string_literal) (FPSTR(PSTR(string_literal)))
            String newString = parseTemplate(tmpString, 16);
            //Plugin_023_sendStrXY(OLED_Settings[index],newString.c_str(), x, 0);
            String logTmpl1 = "TEMPLATE #" + String(x) + ".1 = " + tmpString;
            addLog(LOG_LEVEL_INFO, logTmpl1);
            String logTmpl2 = "TEMPLATE #" + String(x) + ".2 = " + newString;
            addLog(LOG_LEVEL_INFO, logTmpl2);

            if(x == 0) {
              //P230_update_time(prev_row1, newString);
              //prev_row1 = newString;
              P230_display_temperature(newString, prev_row1);
              prev_row1 = newString;
            }
            else if(x == 1) {
              P230_display_humidity(newString, prev_row2);
              prev_row2 = newString;
            }
          }
        }
        success = false;
        break;
      }

    case PLUGIN_WRITE:
      {
        success = false;

        break;
      }
  }
  return success;
}

void P230_initialize() {
  //prev_temp = TEMP_MAXVALUE;

  tft = new Adafruit_ILI9341(TFT_CS, TFT_DC);
  tft->begin();
  tft->setRotation(TFT_ROTATE);

  // General
  tft->fillScreen(SCREEN_BGCOLOR);

  // Title
  tft->setFont(&Roboto_Light7pt7b);
  tft->setTextColor(SCREEN_TITLECOLOR);
  P230_print_str(Settings.Name, 1, 7, 18);

  // Panels
  P230_draw_panel(SCREEN_PANEL1_BGCOLOR, 0,    28, 240, 60);
  P230_draw_panel(SCREEN_PANEL2_BGCOLOR, 0,    88, 120, 60);
  P230_draw_panel(SCREEN_PANEL3_BGCOLOR, 120,  88, 120, 60);
  P230_draw_panel(SCREEN_PANEL4_BGCOLOR, 0,   148, 120, 60);
  P230_draw_panel(SCREEN_PANEL5_BGCOLOR, 120, 148, 120, 60);

  // Icons
  tft->drawXBitmap(25,   38, days_bits,        40, 40, SCREEN_FGCOLOR);
  tft->drawXBitmap(7,    98, temperature_bits, 40, 40, SCREEN_FGCOLOR);
  tft->drawXBitmap(129,  98, drop_bits,        40, 40, SCREEN_FGCOLOR);
  tft->drawXBitmap(10,  159, water_bits,       40, 40, SCREEN_FGCOLOR);
  tft->drawXBitmap(130, 159, sun_bits,         40, 40, SCREEN_FGCOLOR);

  // Relays
  tft->setFont(&Roboto_Light7pt7b);
  tft->setTextColor(SCREEN_FGCOLOR);

  // Heater
  //update_heater_status(false);
  //print_str("Heater", 1, 60, 235);

  // Misting
  //update_misting_status(false);
  //print_str("Misting", 1, 60, 260);

  // Light
  //update_light_status(false);
  //print_str("Light", 1, 60, 285);

  // Fan
  //update_fan_status(false);
  //print_str("Fan", 1, 180, 235);

  // Fogger
  //update_fogger_status(false);
  //print_str("Fogger", 1, 180, 260);
}

/** ==============================================================================================
WIFI
==============================================================================================  */
void P230_display_wifi_status(bool is_connected, String ip_address_1, String ip_address_2) {
	unsigned int color = SCREEN_WIFIDEACTIVATED;
	if(is_connected) {
		color = SCREEN_WIFIACTIVATED;
	}

	tft->fillRect(215, 18, 4, 4,  color);
	tft->fillRect(220, 14, 4, 8,  color);
	tft->fillRect(225, 10, 4, 12, color);
	tft->fillRect(230, 6,  4, 16, color);

	P230_display_ip_addresses(ip_address_1, ip_address_2);
}

//void P230_display_wifi_ap_status(String ip_address) {
	//if(!wifi_ap_displayed) {
//		P230_display_ip_addresses(ip_address_1, ip_address);
	//	wifi_ap_displayed = true;
	//}
//}

void P230_display_ip_addresses(String ip_address_fg, String ip_address_bg) {
  tft->setFont(&Roboto_Light6pt7b);
  P230_print_str(SCREEN_BGCOLOR, ip_address_bg, SCREEN_FGCOLOR, ip_address_fg, 1, 75, 18);
}

/** ==============================================================================================
DATE and TIME
==============================================================================================  */
void P230_update_date(String str_date1, String str_date2) {
  P230_update_date(str_date1, SCREEN_PANEL1_BGCOLOR);
  P230_update_date(str_date2, SCREEN_FGCOLOR);
  /*if(year != prev_year || month != prev_month || day != prev_day) {
    String str_month = get_month(month);
    String str_prev_month = get_month(prev_month);

    String prev_date = String(prev_day) + " " + str_prev_month + " " + String(prev_year);
    String date = String(day) + " " + str_month + " " + String(year);
*/
}
void P230_update_date(String str_date, unsigned int fg_color) {
    tft->setFont(&Roboto_Light10pt7b);

    tft->setTextColor(fg_color);
    P230_print_str(str_date, 1, 72, 77); // 10
}

String P230_get_month(short month) {
  String str_month = "";
  switch(month) {
    case 1: str_month = "Jan."; break;
    case 2: str_month = "Feb."; break;
    case 3: str_month = "Mar."; break;
    case 4: str_month = "Apr."; break;
    case 5: str_month = "May"; break;
    case 6: str_month = "Jun."; break;
    case 7: str_month = "Jul."; break;
    case 8: str_month = "Aug."; break;
    case 9: str_month = "Sep."; break;
    case 10: str_month = "Oct."; break;
    case 11: str_month = "Nov."; break;
    case 12: str_month = "Dec."; break;
  }

  return str_month;
}
void P230_update_time(String str_time1, String str_time2) {
  P230_update_time(str_time1, SCREEN_PANEL1_BGCOLOR);
  P230_update_time(str_time2, SCREEN_FGCOLOR);
}

void P230_update_time(String str_time, unsigned int fg_color) {
  if(str_time.length() > 0) {
    int idx = str_time.lastIndexOf(':');
    if(idx > 0) {
      String str_hhmm = str_time.substring(0, idx);
      String str_ss = str_time.substring(idx);

      tft->setFont(&Roboto_Light16pt7b); // 16
      tft->setTextColor(fg_color);
      P230_print_str(str_hhmm, 1, 72, 59, false);
      tft->setFont(&Roboto_Light12pt7b); // 12
      P230_print_str(str_ss, 1, true);
    }
  }
}

/** ==============================================================================================
TEMPERATURE
==============================================================================================  */
void P230_display_temperature(String temp, String prev_temp) {
	/*String str_prevtemp = "--";
	if(prev_temp < TEMP_MAXVALUE) {
		str_prevtemp = String(prev_temp, 1);
	}

	String str_newtemp = "--";
	if(temp < TEMP_MAXVALUE) {
		str_newtemp = String(temp, 1);
	}*/

	tft->setFont(&Roboto_Light17pt7b);
	P230_print_str(SCREEN_PANEL2_BGCOLOR, prev_temp, SCREEN_FGCOLOR, temp, 1, 50, 128);
}

/** ==============================================================================================
HUMIDITY
==============================================================================================  */
void P230_display_humidity(String hum, String prev_hum) {
	/*String str_prevhum = "--";
	if(prev_hum > 0 && prev_hum < 100) {
		str_prevhum = String(prev_hum, 1);
	}

	String str_newhum = "--";
	if(hum > 0 && hum < 100) {
		str_newhum = String(hum, 1);
	}*/

	tft->setFont(&Roboto_Light17pt7b);
	P230_print_str(SCREEN_PANEL3_BGCOLOR, prev_hum, SCREEN_FGCOLOR, hum, 1, 170, 128);
}

/** ==============================================================================================
PRINT FUNCTIONS
==============================================================================================  */
void P230_print_str(const String &txt, unsigned int size, unsigned int x, unsigned int y) {
	P230_print_str(txt, size, x, y, true);
}

void P230_print_str(const String &txt, unsigned int size, unsigned int x, unsigned int y, bool newline) {
  tft->setCursor(x, y);
  P230_print_str(txt, size, newline);
}

void P230_print_str(const String &txt, unsigned int size, bool newline) {
	tft->setTextSize(size);
	if(newline) {
		tft->println(txt);
	}
	else {
		tft->print(txt);
	}
}

void P230_print_str(unsigned int bg_color, String prev_str, unsigned int fg_color, String str, unsigned int size, unsigned int x, unsigned int y) {
	P230_print_str(bg_color, prev_str, fg_color, str, size, x, y, true);
}

void P230_print_str(unsigned int bg_color, String prev_str, unsigned int fg_color, String str, unsigned int size, unsigned int x, unsigned int y, bool newline) {
  tft->setTextColor(bg_color);
  P230_print_str(prev_str, size, x, y, newline);

  tft->setTextColor(fg_color);
  P230_print_str(str, size, x, y, newline);
}

void P230_draw_panel(uint16_t bgcolor, int16_t x, int16_t y, int16_t w, int16_t h) {
  tft->fillRect(x, y, w, h, bgcolor);
}

#endif // USES_P230
